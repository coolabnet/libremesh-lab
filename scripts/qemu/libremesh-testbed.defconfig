## scripts/qemu/libremesh-testbed.defconfig
```kconfig
CONFIG_TARGET_x86=y
CONFIG_TARGET_x86_64=y
CONFIG_TARGET_x86_64_DEVICE_generic=y
CONFIG_PACKAGE_kmod-mac80211-hwsim=y
CONFIG_PACKAGE_vwifi=y
CONFIG_PACKAGE_bmx7=y
CONFIG_PACKAGE_babeld=y
CONFIG_PACKAGE_ip-full=y
CONFIG_PACKAGE_iwinfo=y
CONFIG_PACKAGE_uc=y
CONFIG_PACKAGE_ubus=y
CONFIG_PACKAGE_uhttpd=y
CONFIG_PACKAGE_python3-light=y
CONFIG_PACKAGE_netcat=y
CONFIG_PACKAGE_iw=y
CONFIG_PACKAGE_lime-system=y
CONFIG_PACKAGE_lime-proto-bmx7=y
CONFIG_CCACHE=y
```
